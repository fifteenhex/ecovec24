## br2external/Config.in
```kconfig
source "$BR2_EXTERNAL_ECOVEC24_PATH/package/tlwpy/Config.in"
source "$BR2_EXTERNAL_ECOVEC24_PATH/package/tlwbe_heartbeat/Config.in"
source "$BR2_EXTERNAL_ECOVEC24_PATH/package/nodectrl/Config.in"
```

## br2external/package/nodectrl/Config.in
```kconfig
config BR2_PACKAGE_NODECTRL
	bool "nodectrl"
	select BR2_PACKAGE_GLIB_NETWORKING
	select BR2_PACKAGE_HOST_PKGCONF
	select BR2_PACKAGE_MOSQUITTO
	select BR2_PACKAGE_JSON_GLIB

config BR_PACKAGE_NODECTRL_MQTT_HOST
	string "mqtt host"
	depends on BR2_PACKAGE_NODECTRL

config BR_PACKAGE_NODECTRL_NODENAME
	string "node name"
	depends on BR2_PACKAGE_NODECTRL
```

## br2external/package/tlwbe_heartbeat/Config.in
```kconfig
config BR2_PACKAGE_TLWBE_HEARTBEAT
        bool "tlwbe_heartbeat"
	select BR2_PACKAGE_PYTHON3
	select BR2_PACKAGE_PYTHON_DAEMONIZE
        help
          tlwbe heartbeat

config BR2_PACKAGE_TLWBE_HEARTBEAT_MQTT_HOST
        string "mqtt host"
        depends on BR2_PACKAGE_TLWBE_HEARTBEAT

config BR2_PACKAGE_TLWBE_HEARTBEAT_SERIAL_PORT
	string "serial port"
	depends on BR2_PACKAGE_TLWBE_HEARTBEAT

config BR2_PACKAGE_TLWBE_HEARTBEAT_GATEWAY_ID
	string "gateway id"
	depends on BR2_PACKAGE_TLWBE_HEARTBEAT

config BR2_PACKAGE_TLWBE_HEARTBEAT_APP_EUI
        string "app eui"
        depends on BR2_PACKAGE_TLWBE_HEARTBEAT

config BR2_PACKAGE_TLWBE_HEARTBEAT_DEV_EUI
        string "dev eui"
        depends on BR2_PACKAGE_TLWBE_HEARTBEAT

config BR2_PACKAGE_TLWBE_HEARTBEAT_DEV_KEY
        string "dev key"
        depends on BR2_PACKAGE_TLWBE_HEARTBEAT
```

## br2external/package/tlwpy/Config.in
```kconfig
config BR2_PACKAGE_TLWPY
	bool "tlwpy"
	depends on BR2_PACKAGE_HAS_OPENSSL
	select BR2_PACKAGE_HOST_PYTHON_CYTHON
	select BR2_PACKAGE_PYTHON_SERIAL
```
